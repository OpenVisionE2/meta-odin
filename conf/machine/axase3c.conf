## conf/machine/axase3c.conf
```bitbake
#
# This is config file for Axas E3HD-C
#

MTD_KERNEL = "mtd1"
MTD_ROOTFS = "mtd2"

IMAGEDIR = "e3hd"

MACHINE_ESSENTIAL_EXTRA_RDEPENDS += "\
    odin-dvb-modules-e3hd \
    "

PREFERRED_PROVIDER_virtual/blindscan-dvbc = "odin-blindscan-utils-e3hd"
PREFERRED_PROVIDER_virtual/blindscan-dvbs = "odin-blindscan-utils-e3hd"

require conf/machine/include/odin-oem.inc

SOC_FAMILY = "bcm7358"

PREFERRED_VERSION_linux-odin = "3.18.24"

MACHINE_FEATURES += "videoenhancement blindscan-tbs dvb-c dvbc-only"
```

## conf/machine/galaxym6.conf
```bitbake
#
# This is config file for T-rex GalaxyM6
#

MTD_KERNEL = "mtd3"
MTD_ROOTFS = "mtd4"

IMAGEDIR = "en2"

MACHINE_ESSENTIAL_EXTRA_RDEPENDS = "\
    odin-dvb-modules-odinm7 \
    "

PREFERRED_PROVIDER_virtual/blindscan-dvbc = "odin-blindscan-utils-odinm7"
PREFERRED_PROVIDER_virtual/blindscan-dvbs = "odin-blindscan-utils-odinm7"

require conf/machine/include/odin-oem.inc

SOC_FAMILY = "bcm7358"

PREFERRED_PROVIDER_virtual/kernel = "linux-odinm7"
PREFERRED_VERSION_linux-odinm7 = "3.18.24"

MACHINE_FEATURES += "videoenhancement singlecore blindscan-tbs 7segment textlcd"
#MACHINE_FEATURES += "no-cl-svr"
```

## conf/machine/maram9.conf
```bitbake
#
# This is config file for ODIN M9
#

MTD_KERNEL = "mtd2"
MTD_ROOTFS = "mtd3"

IMAGEDIR = "odinm9"

MACHINE_ESSENTIAL_EXTRA_RDEPENDS = "\
    odin-dvb-modules-odinm9 \
    "

PREFERRED_PROVIDER_virtual/blindscan-dvbc = "odin-blindscan-utils-odinm9"
PREFERRED_PROVIDER_virtual/blindscan-dvbs = "odin-blindscan-utils-odinm9"

require conf/machine/include/odin-oem.inc

SOC_FAMILY = "bcm7413"

PREFERRED_PROVIDER_virtual/kernel = "linux-odinm9"
PREFERRED_VERSION_linux-odinm9 = "3.6.0"

MACHINE_FEATURES += "ci fanctrl textlcd"
#MACHINE_FEATURES += "skins1080 boxmodel"
```

## conf/machine/starsatlx.conf
```bitbake
#
# This is config file for Starsat LX
#

MTD_KERNEL = "mtd3"
MTD_ROOTFS = "mtd4"

IMAGEDIR = "en2"

MACHINE_ESSENTIAL_EXTRA_RDEPENDS += "\
    odin-dvb-modules-odinm7 \
    "

PREFERRED_PROVIDER_virtual/blindscan-dvbc = "odin-blindscan-utils-odinm7"
PREFERRED_PROVIDER_virtual/blindscan-dvbs = "odin-blindscan-utils-odinm7"

require conf/machine/include/odin-oem.inc

SOC_FAMILY = "bcm7358"

PREFERRED_VERSION_linux-odin = "3.18.24"

MACHINE_FEATURES += "videoenhancement blindscan-tbs 7segment textlcd"
```
